## IC_team5/yocto/meta-team5/conf/layer.conf
```bitbake
BBPATH =. "${LAYERDIR}:"
BBFILES += "${LAYERDIR}/recipes*/*.bb \
	    ${LAYERDIR}/recipes*/*/*.bbappend"

BBFILE_COLLECTIONS += "meta-team5"
BBFILE_PATTERN_meta-team5 = "^${LAYERDIR}/"
BBFILE_PRIORITY_meta-team5 = "100"
LAYERSERIES_COMPAT_meta-team5 = "kirkstone"
```
